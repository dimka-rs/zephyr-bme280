## boards/arm/ebyte_nrf52805/Kconfig.defconfig
```kconfig
# EBYTE nRF52805 board configuration

# SPDX-License-Identifier: Apache-2.0

if BOARD_EBYTE_NRF52805

config BOARD
	default "ebyte_nrf52805"

config BT_CTLR
	default BT

endif # BOARD_EBYTE_NRF52805
```
